## app/boards/arm/thumbsplit60ble/Kconfig.board
```kconfig
# Copyright (c) 2024 Kazuyuki Arimatsu
# SPDX-License-Identifier: MIT

config BOARD_THUMBSPLIT60_BLE_LEFT
	bool "thumbsplit60ble_left"
	depends on SOC_NRF52840_QIAA

config BOARD_THUMBSPLIT60_BLE_RIGHT
	bool "thumbsplit60ble_right"
	depends on SOC_NRF52840_QIAA
```

## app/boards/arm/thumbsplit60ble/Kconfig.defconfig
```kconfig
# Copyright (c) 2024 Kazuyuki Arimatsu
# SPDX-License-Identifier: MIT

if BOARD_THUMBSPLIT60_BLE_RIGHT

config ZMK_KEYBOARD_NAME
	# This must be less than 16 characters long
	default "Thumbsplit60 BLE"

# Right central configuration for Thumbsplit60
config ZMK_SPLIT_BLE_ROLE_CENTRAL
	default y

endif #BOARD_THUMBSPLIT60_BLE_RIGHT

if BOARD_THUMBSPLIT60_BLE_LEFT || BOARD_THUMBSPLIT60_BLE_RIGHT

config ZMK_SPLIT
	default y

if USB

config USB_NRFX
	default y

config USB_DEVICE_STACK
	default y

endif # USB

config BT_CTLR
    default BT

endif # BOARD_THUMBSPLIT60_BLE_LEFT || BOARD_THUMBSPLIT60_BLE_RIGHT
```

## app/boards/arm/thumbsplit60ble/thumbsplit60ble_right_defconfig
```kconfig
# Copyright (c) 2024 Kazuyuki Arimatsu
# SPDX-License-Identifier: MIT

CONFIG_SOC_SERIES_NRF52X=y
CONFIG_SOC_NRF52840_QIAA=y
CONFIG_BOARD_THUMBSPLIT60_BLE_RIGHT=y

CONFIG_ARM_MPU=y
CONFIG_PINCTRL=y
CONFIG_GPIO=y

CONFIG_USE_DT_CODE_PARTITION=y
CONFIG_BUILD_OUTPUT_UF2=y

CONFIG_MPU_ALLOW_FLASH_WRITE=y
CONFIG_NVS=y
CONFIG_SETTINGS_NVS=y
CONFIG_FLASH=y
CONFIG_FLASH_PAGE_LAYOUT=y
CONFIG_FLASH_MAP=y

CONFIG_CLOCK_CONTROL_NRF_K32SRC_XTAL=y
CONFIG_CLOCK_CONTROL_NRF_K32SRC_20PPM=y

CONFIG_ZMK_USB=y
CONFIG_ZMK_BLE=y
CONFIG_ZMK_SPLIT_BLE_CENTRAL_BATTERY_LEVEL_PROXY=y
CONFIG_ZMK_SPLIT_BLE_CENTRAL_BATTERY_LEVEL_FETCHING=y
CONFIG_ZMK_SLEEP=y

CONFIG_ZMK_DISPLAY_STATUS_SCREEN_BUILT_IN=y
CONFIG_ZMK_LV_FONT_DEFAULT_SMALL_MONTSERRAT_26=y
CONFIG_LV_FONT_DEFAULT_MONTSERRAT_26=y
CONFIG_ZMK_WIDGET_BATTERY_STATUS_SHOW_PERCENTAGE=y
```

## boards/arm/thumbsplit60ble/Kconfig.defconfig
```kconfig
# Copyright (c) 2024 Kazuyuki Arimatsu
# SPDX-License-Identifier: MIT

if BOARD_THUMBSPLIT60_BLE_RIGHT

config ZMK_KEYBOARD_NAME
	# This must be less than 16 characters long
	default "Thumbsplit60 BLE"

# Right central configuration for Thumbsplit60
config ZMK_SPLIT_BLE_ROLE_CENTRAL
	default y

config THUMBSPLIT60_BLE_WIDGET_STATUS
    bool "Custom Thumbsplit60 BLE status widget"
	default y

    select LV_OBJ_LABEL
    imply LV_USE_THEME_MONO
    imply ZMK_WIDGET_LAYER_STATUS
    imply ZMK_WIDGET_BATTERY_STATUS
    imply ZMK_WIDGET_OUTPUT_STATUS

    select LV_FONT_MONTSERRAT_12
    select LV_FONT_MONTSERRAT_16
    select LV_FONT_MONTSERRAT_26

config LV_Z_MEM_POOL_SIZE
    default 4096 if THUMBSPLIT60_BLE_WIDGET_STATUS

endif #BOARD_THUMBSPLIT60_BLE_RIGHT

if BOARD_THUMBSPLIT60_BLE_LEFT || BOARD_THUMBSPLIT60_BLE_RIGHT

config ZMK_SPLIT
	default y

if USB

config USB_NRFX
	default y

config USB_DEVICE_STACK
	default y

endif # USB

config BT_CTLR
    default BT

endif # BOARD_THUMBSPLIT60_BLE_LEFT || BOARD_THUMBSPLIT60_BLE_RIGHT
```
